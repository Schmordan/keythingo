## boards/shields/jorleo17/Kconfig.defconfig
```kconfig
if SHIELD_JORLEO17

config ZMK_KEYBOARD_NAME
    default "keythingo"

config ZMK_KSCAN
    default y

config ZMK_KSCAN_GPIO_DIRECT
    default y

endif # SHIELD_JORLEO17
```
